## boards/arm/sophi_arcade/Kconfig.board
```kconfig
config BOARD_SOPHI_ARCADE
	bool "STM32F407VET6 Development Board"
	depends on SOC_STM32F407XG
```

## boards/arm/sophi_arcade/Kconfig.defconfig
```kconfig
if BOARD_SOPHI_ARCADE

config BOARD
	default "stm32f4_disco"

config UART_2
	default y

config PWM_STM32_2
	default y

config SPI
	default y
config SPI_1
	default y

config FLASH
	default y

config SPI_FLASH_W25QXXDV
	default y

config SPI_FLASH_W25QXXDV_GPIO_SPI_CS
	default y

config DISK_ACCESS_FLASH
	default y

config DISK_FLASH_DEV_NAME
	default SPI_FLASH_W25QXXDV_DRV_NAME

config DISK_FLASH_START
	default 0x0

config DISK_FLASH_MAX_RW_SIZE
	default 256

config DISK_ERASE_BLOCK_SIZE
	default 0x1000

config DISK_FLASH_ERASE_ALIGNMENT
	default 0x1000

config DISK_VOLUME_SIZE
	default 0x200000

endif # BOARD_SOPHI_ARCADE
```

## boards/arm/sophi_arcade/sophi_arcade_defconfig
```kconfig
CONFIG_ARM=y
CONFIG_BOARD_SOPHI_ARCADE=y
CONFIG_SOC_SERIES_STM32F4X=y
CONFIG_SOC_STM32F407XG=y
CONFIG_CORTEX_M_SYSTICK=y

# 168MHz system clock
CONFIG_SYS_CLOCK_HW_CYCLES_PER_SEC=168000000
CONFIG_SYS_CLOCK_TICKS_PER_SEC=1000

# Enable MPU
CONFIG_ARM_MPU=y

CONFIG_SERIAL=y

# console
CONFIG_CONSOLE=y
CONFIG_UART_CONSOLE=y

# enable pinmux
CONFIG_PINMUX=y

# enable GPIO
CONFIG_GPIO=y

# shell
CONFIG_SHELL=y

# clock configuration
CONFIG_CLOCK_CONTROL=y

# Clock configuration for Cube Clock control driver
CONFIG_CLOCK_STM32_HSE_CLOCK=8000000
CONFIG_CLOCK_STM32_SYSCLK_SRC_PLL=y

# use HSE as PLL input
CONFIG_CLOCK_STM32_PLL_SRC_HSE=y

# produce 168MHz clock at PLL output
CONFIG_CLOCK_STM32_PLL_M_DIVISOR=4
CONFIG_CLOCK_STM32_PLL_N_MULTIPLIER=168
CONFIG_CLOCK_STM32_PLL_P_DIVISOR=2
CONFIG_CLOCK_STM32_PLL_Q_DIVISOR=7
CONFIG_CLOCK_STM32_AHB_PRESCALER=1
CONFIG_CLOCK_STM32_APB1_PRESCALER=4
CONFIG_CLOCK_STM32_APB2_PRESCALER=2

# enable pwm
CONFIG_PWM=y

# flash
CONFIG_FLASH=y

# usb
CONFIG_USB=y
CONFIG_USB_DEVICE_STACK=y
CONFIG_USB_DEVICE_VID=0x50F1
CONFIG_USB_DEVICE_PID=0x0001
CONFIG_USB_DEVICE_MANUFACTURER="SONGPHI"
CONFIG_USB_DEVICE_PRODUCT="SOPHI_ARCADE"
CONFIG_USB_DEVICE_SN="SPARCADE0001"

CONFIG_GPIO=y
CONFIG_GPIO_SHELL=y

CONFIG_LOG=y
CONFIG_LOG_BACKEND_UART=y

CONFIG_SPI=y

CONFIG_SPI_1=y

CONFIG_DISK_FLASH_VOLUME_NAME="NAND"

CONFIG_SPI_2=y
CONFIG_DISK_ACCESS=y
CONFIG_DISK_ACCESS_SDHC=y
CONFIG_DISK_SDHC_VOLUME_NAME="SD"


CONFIG_FILE_SYSTEM=y
CONFIG_FAT_FILESYSTEM_ELM=y
CONFIG_FILE_SYSTEM_SHELL=y
CONFIG_PRINTK=y

CONFIG_USB_MASS_STORAGE=y
CONFIG_MASS_STORAGE_DISK_NAME="SD"


CONFIG_HEAP_MEM_POOL_SIZE=16384

CONFIG_RTC=y
CONFIG_RTC_STM32=y
# RTC_STM32_CLOCK_SRC
CONFIG_RTC_STM32_CLOCK_LSI=y

CONFIG_ENTROPY_GENERATOR=y
CONFIG_ENTROPY_STM32_RNG=y
```
